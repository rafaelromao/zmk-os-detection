## Kconfig
```kconfig
# Kconfig functions split their arguments on commas, so the compatible (which
# contains one) must go through a variable first. Same pattern as ZMK itself.
DT_COMPAT_ZMK_OS_DETECTION := zmk,os-detection

config ZMK_OS_DETECTION
 bool "Drive a layer from the operating system detected on the host"
 default $(dt_compat_enabled,$(DT_COMPAT_ZMK_OS_DETECTION))
 depends on !ZMK_SPLIT || ZMK_SPLIT_ROLE_CENTRAL
 help
   Watches how the host reads the keyboard's descriptors -- over USB while it
   enumerates, over BLE while it discovers services -- and turns the layer
   named by a zmk,os-detection node on or off to match the operating system
   that behaviour points at.

   Enabled automatically when a zmk,os-detection node is present in the
   keymap. Only built on the central/unibody side, which is the side with a
   host.

   The two transports are independent and each can be turned off on its own.
   Neither is required: with both off the node is inert.

if ZMK_OS_DETECTION

config ZMK_OS_DETECTION_USB
 bool "Fingerprint the host's USB enumeration"
 default y
 depends on ZMK_USB && USB_DEVICE_STACK
 select USB_DEVICE_BOS
 help
   Counts the shape of the GET_DESCRIPTOR(STRING) requests the host makes
   while enumerating. macOS probes each descriptor with a 2-byte header read
   and then re-reads it in full; Linux reads every string directly at 255.

   Observed by linker-wrapping usb_handle_bos(), which Zephyr's legacy USB
   device stack calls for every standard setup packet. That symbol only
   exists when USB_DEVICE_BOS is set, hence the select -- see the comment in
   src/os_detection_usb.c for what that implies for the device descriptor.

config ZMK_OS_DETECTION_USB_SETTLE_MS
 int "Quiet time (ms) after the last setup packet before the USB guess is read"
 default 200
 depends on ZMK_OS_DETECTION_USB

config ZMK_OS_DETECTION_USB_STALE_MS
 int "Quiet time (ms) after which the counts belong to a previous host"
 default 500
 depends on ZMK_OS_DETECTION_USB
 help
   One enumeration's descriptor reads arrive in a burst: usbmon captures of a
   Linux host put the whole sequence inside 20 ms, the worst seen being 17.
   Switching a KVM, replugging, or waking a second machine is seconds away
   from that. A gap this long therefore means the packet after it opens a new
   enumeration, and the counts so far describe a different computer.

   Well above a burst and well below a switch, so neither boundary is near.
   Raise it only if a host is found splitting one enumeration across a longer
   pause than this.

config ZMK_OS_DETECTION_BLE
 bool "Fingerprint the host's GATT service discovery"
 default y
 depends on ZMK_BLE
 help
   Counts which characteristics the host reads while discovering services.
   A BlueZ desktop reads GAP Appearance and the DIS PnP ID on top of the HID
   report map; macOS reads the report map and leaves those alone.

   Weaker than the USB fingerprint, and blind to the difference between macOS
   and an Android phone. Confirm it against your own hosts -- the per-profile
   counters are logged at debug level -- before relying on it.

config ZMK_OS_DETECTION_BLE_SETTLE_MS
 int "Quiet time (ms) after the last fingerprint read before the BLE guess is read"
 default 1000
 depends on ZMK_OS_DETECTION_BLE
 help
   Larger than the USB figure because discovery reads are spread across a
   slower connection interval.

endif # ZMK_OS_DETECTION
```

## dts/bindings/zmk,os-detection.yaml
```yaml
# Copyright (c) 2026 Rafael Romão
# SPDX-License-Identifier: MIT

description: |
    OS Detection

    Drives one layer from the operating system detected on whichever host is
    currently selected.

    The layer is a mode relative to the OS the firmware was built for, so this
    node does not name a "base OS". It names, for each detected OS, the state
    the layer should be in. An OS in neither list -- including a host that was
    not recognised at all -- leaves the layer alone, so whatever set it stands:
    a zmk,persistent-layers replay, or the user.

    The lists are turned into bitmasks at build time, so a name that is not a
    known OS fails the build rather than silently never matching.

compatible: "zmk,os-detection"

properties:
    layer:
        type: int
        required: true
        description: |
            The layer this node drives. It never reads or writes any other
            layer. Use a layer held by a locking toggle: this node activates
            and deactivates with locking, so that it cannot fight -- or be
            quietly undone by -- a layer set with &lock_on.

    activate-for:
        type: string-array
        required: true
        description: |
            Detected operating systems that turn the layer on. Valid names are
            "macos" and "linux".

    deactivate-for:
        type: string-array
        required: true
        description: |
            Detected operating systems that turn the layer off. Valid names are
            "macos" and "linux".

    settle-ms:
        type: int
        default: 50
        description: |
            How long to wait after an endpoint change before writing the layer.

            Its only job is to put this node's write after every synchronous
            listener of zmk_endpoint_changed -- notably a zmk,persistent-layers
            replay, whose order relative to this one is decided by link order
            and is not otherwise controllable. This is not the detection
            debounce; those are the two Kconfig settle values.
```
